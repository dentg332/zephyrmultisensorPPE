## build/Kconfig/arch/Kconfig
```kconfig
# Load Zephyr Arch Kconfig descriptions.
osource "C:/Users/Usuario/zephyrTFMproject/zephyr/arch/rx/Kconfig"
osource "C:/Users/Usuario/zephyrTFMproject/zephyr/arch/x86/Kconfig"
osource "C:/Users/Usuario/zephyrTFMproject/zephyr/arch/xtensa/Kconfig"
osource "C:/Users/Usuario/zephyrTFMproject/zephyr/arch/sparc/Kconfig"
osource "C:/Users/Usuario/zephyrTFMproject/zephyr/arch/riscv/Kconfig"
osource "C:/Users/Usuario/zephyrTFMproject/zephyr/arch/posix/Kconfig"
osource "C:/Users/Usuario/zephyrTFMproject/zephyr/arch/mips/Kconfig"
osource "C:/Users/Usuario/zephyrTFMproject/zephyr/arch/arm64/Kconfig"
osource "C:/Users/Usuario/zephyrTFMproject/zephyr/arch/arm/Kconfig"
osource "C:/Users/Usuario/zephyrTFMproject/zephyr/arch/arc/Kconfig"
```

## build/Kconfig/boards/Kconfig
```kconfig
# Load Zephyr board Kconfig descriptions.
osource "C:/Users/Usuario/zephyrTFMproject/zephyr/boards/st/nucleo_wl55jc/Kconfig"
```

## build/Kconfig/boards/Kconfig.defconfig
```kconfig
# Load Zephyr board defconfig descriptions.
osource "C:/Users/Usuario/zephyrTFMproject/zephyr/boards/st/nucleo_wl55jc/Kconfig.defconfig"
```

## build/Kconfig/boards/Kconfig.nucleo_wl55jc
```kconfig
# Load board Kconfig descriptions.
osource "C:/Users/Usuario/zephyrTFMproject/zephyr/boards/st/nucleo_wl55jc/Kconfig.nucleo_wl55jc"
```

## build/Kconfig/boards/Kconfig.sysbuild
```kconfig
# Load Sysbuild board Kconfig descriptions.
osource "C:/Users/Usuario/zephyrTFMproject/zephyr/boards/st/nucleo_wl55jc/Kconfig.sysbuild"
```

## build/Kconfig/soc/Kconfig.defconfig
```kconfig
# Load Zephyr SoC defconfig descriptions.
osource "C:/Users/Usuario/zephyrTFMproject/zephyr/soc/xlnx/zynqmp/Kconfig.defconfig"
osource "C:/Users/Usuario/zephyrTFMproject/zephyr/soc/xlnx/zynq7000/Kconfig.defconfig"
osource "C:/Users/Usuario/zephyrTFMproject/zephyr/soc/xlnx/versalnet/Kconfig.defconfig"
osource "C:/Users/Usuario/zephyrTFMproject/zephyr/soc/xlnx/versal2/Kconfig.defconfig"
osource "C:/Users/Usuario/zephyrTFMproject/zephyr/soc/xen/Kconfig.defconfig"
osource "C:/Users/Usuario/zephyrTFMproject/zephyr/soc/wch/ch32v/Kconfig.defconfig"
osource "C:/Users/Usuario/zephyrTFMproject/zephyr/soc/ti/simplelink/Kconfig.defconfig"
osource "C:/Users/Usuario/zephyrTFMproject/zephyr/soc/ti/mspm0/Kconfig.defconfig"
osource "C:/Users/Usuario/zephyrTFMproject/zephyr/soc/ti/lm3s6965/Kconfig.defconfig"
osource "C:/Users/Usuario/zephyrTFMproject/zephyr/soc/ti/k3/Kconfig.defconfig"
osource "C:/Users/Usuario/zephyrTFMproject/zephyr/soc/telink/tlsr/Kconfig.defconfig"
osource "C:/Users/Usuario/zephyrTFMproject/zephyr/soc/starfive/jh71xx/Kconfig.defconfig"
osource "C:/Users/Usuario/zephyrTFMproject/zephyr/soc/st/stm32/Kconfig.defconfig"
osource "C:/Users/Usuario/zephyrTFMproject/zephyr/soc/snps/qemu_arc/Kconfig.defconfig"
osource "C:/Users/Usuario/zephyrTFMproject/zephyr/soc/snps/nsim/arc_v/Kconfig.defconfig"
osource "C:/Users/Usuario/zephyrTFMproject/zephyr/soc/snps/nsim/arc_classic/Kconfig.defconfig"
osource "C:/Users/Usuario/zephyrTFMproject/zephyr/soc/snps/hsdk4xd/Kconfig.defconfig"
osource "C:/Users/Usuario/zephyrTFMproject/zephyr/soc/snps/hsdk/Kconfig.defconfig"
osource "C:/Users/Usuario/zephyrTFMproject/zephyr/soc/snps/emsk/Kconfig.defconfig"
osource "C:/Users/Usuario/zephyrTFMproject/zephyr/soc/snps/emsdp/Kconfig.defconfig"
osource "C:/Users/Usuario/zephyrTFMproject/zephyr/soc/snps/arc_iot/Kconfig.defconfig"
osource "C:/Users/Usuario/zephyrTFMproject/zephyr/soc/silabs/Kconfig.defconfig"
osource "C:/Users/Usuario/zephyrTFMproject/zephyr/soc/sifive/sifive_freedom/Kconfig.defconfig"
osource "C:/Users/Usuario/zephyrTFMproject/zephyr/soc/sensry/Kconfig.defconfig"
osource "C:/Users/Usuario/zephyrTFMproject/zephyr/soc/rockchip/Kconfig.defconfig"
osource "C:/Users/Usuario/zephyrTFMproject/zephyr/soc/renode/riscv_virtual/Kconfig.defconfig"
osource "C:/Users/Usuario/zephyrTFMproject/zephyr/soc/renode/cortex_r8_virtual/Kconfig.defconfig"
osource "C:/Users/Usuario/zephyrTFMproject/zephyr/soc/renesas/smartbond/Kconfig.defconfig"
osource "C:/Users/Usuario/zephyrTFMproject/zephyr/soc/renesas/rz/Kconfig.defconfig"
osource "C:/Users/Usuario/zephyrTFMproject/zephyr/soc/renesas/rx/Kconfig.defconfig"
osource "C:/Users/Usuario/zephyrTFMproject/zephyr/soc/renesas/rcar/Kconfig.defconfig"
osource "C:/Users/Usuario/zephyrTFMproject/zephyr/soc/renesas/ra/Kconfig.defconfig"
osource "C:/Users/Usuario/zephyrTFMproject/zephyr/soc/realtek/ec/Kconfig.defconfig"
osource "C:/Users/Usuario/zephyrTFMproject/zephyr/soc/raspberrypi/rpi_pico/Kconfig.defconfig"
osource "C:/Users/Usuario/zephyrTFMproject/zephyr/soc/quicklogic/eos_s3/Kconfig.defconfig"
osource "C:/Users/Usuario/zephyrTFMproject/zephyr/soc/qemu/virt_riscv/Kconfig.defconfig"
osource "C:/Users/Usuario/zephyrTFMproject/zephyr/soc/qemu/malta/Kconfig.defconfig"
osource "C:/Users/Usuario/zephyrTFMproject/zephyr/soc/openisa/rv32m1/Kconfig.defconfig"
osource "C:/Users/Usuario/zephyrTFMproject/zephyr/soc/openhwgroup/cva6/Kconfig.defconfig"
osource "C:/Users/Usuario/zephyrTFMproject/zephyr/soc/oct/osd32mp15x/Kconfig.defconfig"
osource "C:/Users/Usuario/zephyrTFMproject/zephyr/soc/nxp/s32/Kconfig.defconfig"
osource "C:/Users/Usuario/zephyrTFMproject/zephyr/soc/nxp/rw/Kconfig.defconfig"
osource "C:/Users/Usuario/zephyrTFMproject/zephyr/soc/nxp/mcx/Kconfig.defconfig"
osource "C:/Users/Usuario/zephyrTFMproject/zephyr/soc/nxp/lpc/Kconfig.defconfig"
osource "C:/Users/Usuario/zephyrTFMproject/zephyr/soc/nxp/layerscape/Kconfig.defconfig"
osource "C:/Users/Usuario/zephyrTFMproject/zephyr/soc/nxp/kinetis/Kconfig.defconfig"
osource "C:/Users/Usuario/zephyrTFMproject/zephyr/soc/nxp/imxrt/Kconfig.defconfig"
osource "C:/Users/Usuario/zephyrTFMproject/zephyr/soc/nxp/imx/Kconfig.defconfig"
osource "C:/Users/Usuario/zephyrTFMproject/zephyr/soc/nuvoton/numicro/Kconfig.defconfig"
osource "C:/Users/Usuario/zephyrTFMproject/zephyr/soc/nuvoton/numaker/Kconfig.defconfig"
osource "C:/Users/Usuario/zephyrTFMproject/zephyr/soc/nuvoton/npcx/Kconfig.defconfig"
osource "C:/Users/Usuario/zephyrTFMproject/zephyr/soc/nuvoton/npcm/Kconfig.defconfig"
osource "C:/Users/Usuario/zephyrTFMproject/zephyr/soc/nordic/Kconfig.defconfig"
osource "C:/Users/Usuario/zephyrTFMproject/zephyr/soc/neorv32/Kconfig.defconfig"
osource "C:/Users/Usuario/zephyrTFMproject/zephyr/soc/native/inf_clock/Kconfig.defconfig"
osource "C:/Users/Usuario/zephyrTFMproject/zephyr/soc/microchip/sam/Kconfig.defconfig"
osource "C:/Users/Usuario/zephyrTFMproject/zephyr/soc/microchip/miv/Kconfig.defconfig"
osource "C:/Users/Usuario/zephyrTFMproject/zephyr/soc/microchip/mec/Kconfig.defconfig"
osource "C:/Users/Usuario/zephyrTFMproject/zephyr/soc/mediatek/mt8xxx/Kconfig.defconfig"
osource "C:/Users/Usuario/zephyrTFMproject/zephyr/soc/lowrisc/opentitan/Kconfig.defconfig"
osource "C:/Users/Usuario/zephyrTFMproject/zephyr/soc/litex/litex_vexriscv/Kconfig.defconfig"
osource "C:/Users/Usuario/zephyrTFMproject/zephyr/soc/ite/ec/Kconfig.defconfig"
osource "C:/Users/Usuario/zephyrTFMproject/zephyr/soc/intel/raptor_lake/Kconfig.defconfig"
osource "C:/Users/Usuario/zephyrTFMproject/zephyr/soc/intel/lakemont/Kconfig.defconfig"
osource "C:/Users/Usuario/zephyrTFMproject/zephyr/soc/intel/intel_socfpga_std/Kconfig.defconfig"
osource "C:/Users/Usuario/zephyrTFMproject/zephyr/soc/intel/intel_socfpga/Kconfig.defconfig"
osource "C:/Users/Usuario/zephyrTFMproject/zephyr/soc/intel/intel_niosv/Kconfig.defconfig"
osource "C:/Users/Usuario/zephyrTFMproject/zephyr/soc/intel/intel_ish/Kconfig.defconfig"
osource "C:/Users/Usuario/zephyrTFMproject/zephyr/soc/intel/intel_adsp/Kconfig.defconfig"
osource "C:/Users/Usuario/zephyrTFMproject/zephyr/soc/intel/elkhart_lake/Kconfig.defconfig"
osource "C:/Users/Usuario/zephyrTFMproject/zephyr/soc/intel/atom/Kconfig.defconfig"
osource "C:/Users/Usuario/zephyrTFMproject/zephyr/soc/intel/apollo_lake/Kconfig.defconfig"
osource "C:/Users/Usuario/zephyrTFMproject/zephyr/soc/intel/alder_lake/Kconfig.defconfig"
osource "C:/Users/Usuario/zephyrTFMproject/zephyr/soc/infineon/cat3/Kconfig.defconfig"
osource "C:/Users/Usuario/zephyrTFMproject/zephyr/soc/infineon/cat1c/Kconfig.defconfig"
osource "C:/Users/Usuario/zephyrTFMproject/zephyr/soc/infineon/cat1b/Kconfig.defconfig"
osource "C:/Users/Usuario/zephyrTFMproject/zephyr/soc/infineon/cat1a/Kconfig.defconfig"
osource "C:/Users/Usuario/zephyrTFMproject/zephyr/soc/gd/gd32/Kconfig.defconfig"
osource "C:/Users/Usuario/zephyrTFMproject/zephyr/soc/gaisler/leon3/Kconfig.defconfig"
osource "C:/Users/Usuario/zephyrTFMproject/zephyr/soc/gaisler/gr716a/Kconfig.defconfig"
osource "C:/Users/Usuario/zephyrTFMproject/zephyr/soc/espressif/Kconfig.defconfig"
osource "C:/Users/Usuario/zephyrTFMproject/zephyr/soc/ene/kb1200/Kconfig.defconfig"
osource "C:/Users/Usuario/zephyrTFMproject/zephyr/soc/efinix/sapphire/Kconfig.defconfig"
osource "C:/Users/Usuario/zephyrTFMproject/zephyr/soc/cdns/xtensa_sample_controller/Kconfig.defconfig"
osource "C:/Users/Usuario/zephyrTFMproject/zephyr/soc/cdns/sample_controller32/Kconfig.defconfig"
osource "C:/Users/Usuario/zephyrTFMproject/zephyr/soc/cdns/dc233c/Kconfig.defconfig"
osource "C:/Users/Usuario/zephyrTFMproject/zephyr/soc/brcm/bcmvk/Kconfig.defconfig"
osource "C:/Users/Usuario/zephyrTFMproject/zephyr/soc/brcm/bcm2712/Kconfig.defconfig"
osource "C:/Users/Usuario/zephyrTFMproject/zephyr/soc/brcm/bcm2711/Kconfig.defconfig"
osource "C:/Users/Usuario/zephyrTFMproject/zephyr/soc/bflb/Kconfig.defconfig"
osource "C:/Users/Usuario/zephyrTFMproject/zephyr/soc/atmel/sam0/Kconfig.defconfig"
osource "C:/Users/Usuario/zephyrTFMproject/zephyr/soc/atmel/sam/Kconfig.defconfig"
osource "C:/Users/Usuario/zephyrTFMproject/zephyr/soc/aspeed/Kconfig.defconfig"
osource "C:/Users/Usuario/zephyrTFMproject/zephyr/soc/arm/Kconfig.defconfig"
osource "C:/Users/Usuario/zephyrTFMproject/zephyr/soc/arm/beetle/Kconfig.defconfig"
osource "C:/Users/Usuario/zephyrTFMproject/zephyr/soc/antmicro/myra/Kconfig.defconfig"
osource "C:/Users/Usuario/zephyrTFMproject/zephyr/soc/andestech/Kconfig.defconfig"
osource "C:/Users/Usuario/zephyrTFMproject/zephyr/soc/amd/acp_6_0/Kconfig.defconfig"
osource "C:/Users/Usuario/zephyrTFMproject/zephyr/soc/ambiq/Kconfig.defconfig"
osource "C:/Users/Usuario/zephyrTFMproject/zephyr/soc/aesc/Kconfig.defconfig"
osource "C:/Users/Usuario/zephyrTFMproject/zephyr/soc/adi/max32/Kconfig.defconfig"
```
